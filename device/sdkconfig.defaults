## device/sdkconfig.defaults
```kconfig
# Main task stack (Ed25519 signing during RelayX connect needs ~3KB)
CONFIG_ESP_MAIN_TASK_STACK_SIZE=16384

# FreeRTOS tick rate
CONFIG_FREERTOS_HZ=1000

# LWIP
CONFIG_LWIP_MAX_SOCKETS=16

# Partition table — single_app_large fits the SDK + TLS + sensor driver
CONFIG_PARTITION_TABLE_SINGLE_APP_LARGE=y

# TLS / mbedTLS — NATS over TLS 1.2, uses the default cert bundle
CONFIG_ESP_TLS_USING_MBEDTLS=y
CONFIG_MBEDTLS_SSL_MAX_CONTENT_LEN=16384
CONFIG_MBEDTLS_CERTIFICATE_BUNDLE=y
CONFIG_MBEDTLS_CERTIFICATE_BUNDLE_DEFAULT_FULL=y
CONFIG_MBEDTLS_SSL_PROTO_TLS1_2=y
```
